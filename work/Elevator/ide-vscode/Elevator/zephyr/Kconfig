## work/Elevator/ide-vscode/Elevator/zephyr/boards/shields/elevator/Kconfig.shield
```kconfig
# Copyright (c) 2024 HES-SO Valais, ECS, Sion
# SPDX-License-Identifier: Apache-2.0

config SHIELD_ELEVATOR
	def_bool $(shields_list_contains, elevator)
```

## work/Elevator/ide-vscode/Elevator/zephyr/drivers/Kconfig
```kconfig
# SPDX-License-Identifier: Apache-2.0

menu "Device Drivers"
rsource "sensor/Kconfig"
endmenu
```

## work/Elevator/ide-vscode/Elevator/zephyr/drivers/sensor/Kconfig
```kconfig
# SPDX-License-Identifier: Apache-2.0

if SENSOR
rsource "qdec_rse/Kconfig"
endif # SENSOR
```

## work/Elevator/ide-vscode/Elevator/zephyr/drivers/sensor/qdec_rse/Kconfig
```kconfig
# SPDX-License-Identifier: Apache-2.0
#

#config HEVS_RSE_QDEC_SENSOR
config QDEC_RSE
	bool "RSE QDEC driver"
	default y
	depends on DT_HAS_HEVS_RSE_QDEC_ENABLED
	select USE_STM32_LL_TIM
	help
	  Derivation of the STM32 family Quadrature Decoder driver.
```
